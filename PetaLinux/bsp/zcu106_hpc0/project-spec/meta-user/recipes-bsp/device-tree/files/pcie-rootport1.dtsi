/*
 * zcu106_hpc0 target overlay: second PCIe root port BAR fix.
 *
 * The Makefile copies bsp/zcu106/project-spec first, then overlays
 * bsp/zcu106_hpc0/project-spec on top -- so this file REPLACES the empty stub
 * from bsp/zcu106. The shared system-user.dtsi /include/-s "pcie-rootport1.dtsi",
 * so on this dual-PCIe target the override below is applied in addition to the
 * axi-pcie@b0000000 fix that system-user.dtsi already carries.
 *
 * Declare the second XDMA BAR (0xb8000000, 128 MB) as NON-prefetchable 32-bit
 * memory (the auto-generated DT marks it prefetchable), so the second M.2
 * slot's multi-BAR accelerator gets its non-prefetchable BARs assigned. The
 * prefetchable 64-bit BAR0 (0x550000000, 256 MB) is preserved.
 */
&{/pl-bus/axi-pcie@b8000000} {
    ranges = <0x02000000 0x00 0xb8000000 0x00 0xb8000000 0x00 0x08000000   /* NON-pref 32-bit, 128 MB */
              0x43000000 0x05 0x50000000 0x05 0x50000000 0x00 0x10000000>; /* pref 64-bit, 256 MB  existing */
};
